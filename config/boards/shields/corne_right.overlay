/ {
    chosen {
        zmk,display = &ssd1306;
    };
};

&i2c1 {
    status = "okay";

    ssd1306: ssd1306@3c {
        compatible = "solomon,ssd1306fb";
        reg = <0x3c>;       // I2C address (common default)
        width = <128>;
        height = <32>;
    };
};
